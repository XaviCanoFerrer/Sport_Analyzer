#include "SPI.h"
#include "ILI9341_t3.h"
#include "font_Arial.h"
#include "HX711.h"
#include <Bounce.h>
#include <Encoder.h>
#include <SD.h>

//Encoder variables
Encoder encoder(8,9);
float s = 0;
float s_i = 0;
float v = 0;
elapsedMillis Interval = 0;
unsigned long milliseconds = 10;
const float ppr = 2400; // Encoder Pulses per revolution
const float dpr = 360; // Degrees per revolution
const float mmpp = 0.01; //mm per pulse
bool rotatiional_flag = false;
bool linear_flag = true;

// Button variables
const int buttonPin = 4;
Bounce pushbutton = Bounce(buttonPin, 10);  // 10 ms debounce
byte previousState = HIGH;         // what state was the button last time
unsigned int count = 1;            // how many times has it changed to low
unsigned long countAt = 0;         // when count changed
unsigned int countPrinted = 0;     // last count printed
bool state = LOW;
bool previous_state;

//Maximum number of file names
char fileName[100];

//Load cell variables
HX711 scale;
const int LOADCELL_DOUT_PIN = 2;
const int LOADCELL_SCK_PIN = 3;
long load_cell_reading;

// Display variables
const int chipSelect = 6;
#define TFT_DC      20
#define TFT_CS      21
#define TFT_RST    255  // 255 = unused, connect to 3.3V
#define TFT_MOSI     7
#define TFT_SCLK    14
#define TFT_MISO    12
ILI9341_t3 tft = ILI9341_t3(TFT_CS, TFT_DC, TFT_RST, TFT_MOSI, TFT_SCLK, TFT_MISO);

// Display 16-bit color values:
#define BLUE      0x001F
#define TEAL      0x0438
#define GREEN     0x07E0
#define CYAN      0x07FF
#define RED       0xF800
#define MAGENTA   0xF81F
#define YELLOW    0xFFE0
#define ORANGE    0xFC00
#define PINK      0xF81F
#define PURPLE    0x8010
#define GREY      0xC618
#define WHITE     0xFFFF
#define BLACK     0x0000

boolean display1 = true;
double ox , oy ;
double x, y;

const unsigned char logo [] PROGMEM = {
  
0x00, 0x00, 0x00, 0x00, 0x00, 0x00, 0x00, 0x00, 0x00, 0x00, 0x00, 0x00, 0x00, 0x00, 0x00, 0x00, 
  0x00, 0x00, 0x00, 0x00, 0x00, 0x00, 0x00, 0x00, 0x00, 0x00, 0x00, 0x00, 0x00, 0x00, 0x00, 0x00, 
  0x00, 0x00, 0x00, 0x00, 0x00, 0x00, 0x00, 0x00, 0x00, 0x00, 0x00, 0x00, 0x00, 0x00, 0x00, 0x00, 
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  0x00, 0x00, 0x00, 0x00, 0x00, 0x00, 0x00, 0x00, 0x00, 0x00, 0x00, 0x00, 0x00, 0x00, 0x00, 0x00

};

void setup()
{
  // Start serial communication
  Serial.begin(256000);

  pinMode(buttonPin, INPUT_PULLUP);
  
  //Start load cell ADC communication
  scale.begin(LOADCELL_DOUT_PIN, LOADCELL_SCK_PIN);

  //Start LCD
  tft.begin();
  tft.setRotation(1);
  tft.fillScreen(BLACK);
  tft.setCursor(10, 10);
  tft.setTextColor(WHITE);  
  tft.setTextSize(1);

  // See if the card is present and can be initialized:
  if (!SD.begin(chipSelect)) 
  {
    Serial.println("Card failed, or not present");
    tft.println("Card failed, or not present");
    // don't do anything more:
    return;
  }
  tft.setCursor(110, 120);
  tft.println("Card initialized");
  Serial.println("card initialized");
  delay(1000);
  tft.fillScreen(BLACK);
  delay(1000);

  // Draw the bitmap:
  // drawBitmap(x position, y position, bitmap data, bitmap width, bitmap height, color)
  tft.drawBitmap(0, 0, logo, 320, 240, WHITE);
  delay(2000);
  tft.fillScreen(BLACK);
  
//  Serial.println("CLEARDATA");
//  Serial.println("LABEL,Realtime,Encoder,Load cell,Time(ms)");

  // Open the txt. file and add labels on each column
  //File dataFile = SD.open("data.txt", FILE_WRITE);
  File dataFile = SD.open(fileName, FILE_WRITE);
   
  if (dataFile) 
    {
      dataFile.print("Encoder velocity (mm/s)");
      dataFile.print(";");
      dataFile.print("Load cell force (N)");
      dataFile.print(";");
      dataFile.println("Time (ms)");
      dataFile.flush();
    }  
    // if the file isn't open, pop up an error:
    else 
    {
      Serial.println("error opening datalog.txt");
    } 
  
}

void loop()
{     
   
  for (x = 0; x <= 300; x += 1) 
  {
    //Push button reading
    read_push_button();

    //Load cell reading
    load_cell_reading = abs(scale.read());

    // Rotational encoder reading
    if (rotatiional_flag == true)
      {
        s = encoder.read()*dpr/ppr;
      }
      
    //Linear Encoder reading
    if (linear_flag == true)
      {
        s = -1*encoder.read();
      }

    //Save the data on the SD card
    save_sd_card();

    //Calculate the velocity at a certain interval
    if (Interval > milliseconds) 
      {
        //v = (((s-s_i)*mmpp)/1000)/(float(milliseconds)/1000); // meters per second
        v = ((s-s_i)*mmpp)/(float(milliseconds)/1000); // mm per second
        s_i = s;
        Interval = 0;

        //Plot the selected sensor on the display
        if (state == 0)
          {
            Graph(tft, x, v, 30, 240, 320, 240, 0, 320, 100, 0, 400, 100, "", "", "", WHITE, WHITE, BLUE, WHITE, BLACK, display1);
          }
                
        if (state == 1)
          {
            Graph(tft, x, load_cell_reading, 30, 240, 320, 240, 0, 320, 100, 0, 400, 100, "", "", "", WHITE, WHITE, RED, WHITE, BLACK, display1);
          }
      }
  }
  tft.fillScreen(BLACK);
  display1 = true;
}

void save_sd_card()
{
  //File dataFile = SD.open("data.txt", FILE_WRITE);

  sprintf(fileName, "%d.txt", count);
  File dataFile = SD.open(fileName, FILE_WRITE);
  
  // if the file is available, write to it:
  if (dataFile) 
   {
     //dataFile.println(dataString);
     dataFile.print(v);
     dataFile.print(";");
     dataFile.print(load_cell_reading);
     dataFile.print(";");
     dataFile.println(millis());
     dataFile.flush();
     dataFile.close();
   }  
   // if the file isn't open, pop up an error:
   else 
   {
     Serial.println("error opening datalog.txt");
   } 
  
}


void read_push_button(){
  if (pushbutton.update()) 
  {
    if (pushbutton.fallingEdge()) 
    {
      state = !state;
      count = count + 1;
    }
  } 
}
void serial_print()
{
    Serial.print("DATA,TIME,");
    Serial.print(v);
    Serial.print(","); 
    Serial.print(load_cell_reading);
    Serial.print(","); 
    Serial.print(millis());
}
/*
  function to draw a cartesian coordinate system and plot whatever data you want
  just pass x and y and the graph will be drawn
  huge arguement list
  &d name of your display object
  x = x data point
  y = y datapont
  gx = x graph location (lower left)
  gy = y graph location (lower left)
  w = width of graph
  h = height of graph
  xlo = lower bound of x axis
  xhi = upper bound of x asis
  xinc = division of x axis (distance not count)
  ylo = lower bound of y axis
  yhi = upper bound of y asis
  yinc = division of y axis (distance not count)
  title = title of graph
  xlabel = x axis label
  ylabel = y axis label
  gcolor = graph line colors
  acolor = axis line colors
  pcolor = color of your plotted data
  tcolor = text color
  bcolor = background color
  &redraw = flag to redraw graph on fist call only
*/

void Graph(ILI9341_t3 &d, double x, double y, double gx, double gy, double w, double h, double xlo, double xhi, double xinc, double ylo, double yhi, double yinc, String title, String xlabel, String ylabel, unsigned int gcolor, unsigned int acolor, unsigned int pcolor, unsigned int tcolor, unsigned int bcolor, boolean &redraw) 
{

  double ydiv, xdiv;
  // initialize old x and old y in order to draw the first point of the graph
  // but save the transformed value
  // note my transform funcition is the same as the map function, except the map uses long and we need doubles
  //static double ox = (x - xlo) * ( w) / (xhi - xlo) + gx;
  //static double oy = (y - ylo) * (gy - h - gy) / (yhi - ylo) + gy;
  double i;
  double temp;
  int rot, newrot;

  if (redraw == true) 
  {

    redraw = false;
    ox = (x - xlo) * ( w) / (xhi - xlo) + gx;
    oy = (y - ylo) * (gy - h - gy) / (yhi - ylo) + gy;
    // draw y scale
    for ( i = ylo; i <= yhi; i += yinc) 
    {
      // compute the transform
      temp =  (i - ylo) * (gy - h - gy) / (yhi - ylo) + gy;

      if (i == 0) 
      {
        d.drawLine(gx, temp, gx + w, temp, acolor);
      }
      else 
      {
        d.drawLine(gx, temp, gx + w, temp, gcolor);
      }

      d.setTextSize(1);
      d.setTextColor(tcolor, bcolor);
      d.setCursor(gx - 40, temp);
      // precision is default Arduino--this could really use some format control
      d.println(i);
    }
    // draw x scale
    for (i = xlo; i <= xhi; i += xinc) {

      // compute the transform

      temp =  (i - xlo) * ( w) / (xhi - xlo) + gx;
      if (i == 0) {
        d.drawLine(temp, gy, temp, gy - h, acolor);
      }
      else {
        d.drawLine(temp, gy, temp, gy - h, gcolor);
      }

      d.setTextSize(1);
      d.setTextColor(tcolor, bcolor);
      d.setCursor(temp, gy + 10);
      // precision is default Arduino--this could really use some format control
      d.println(i);
    }

    //now draw the labels
    d.setTextSize(2);
    d.setTextColor(tcolor, bcolor);
    d.setCursor(gx , gy - h - 30);
    d.println(title);

    d.setTextSize(1);
    d.setTextColor(acolor, bcolor);
    d.setCursor(gx , gy + 20);
    d.println(xlabel);

    d.setTextSize(1);
    d.setTextColor(acolor, bcolor);
    d.setCursor(gx - 30, gy - h - 10);
    d.println(ylabel);


  }

  //graph drawn now plot the data
  // the entire plotting code are these few lines...
  // recall that ox and oy are initialized as static above
  x =  (x - xlo) * ( w) / (xhi - xlo) + gx;
  y =  (y - ylo) * (gy - h - gy) / (yhi - ylo) + gy;
  d.drawLine(ox, oy, x, y, pcolor);
  d.drawLine(ox, oy + 1, x, y + 1, pcolor);
  d.drawLine(ox, oy - 1, x, y - 1, pcolor);
  ox = x;
  oy = y;

}
